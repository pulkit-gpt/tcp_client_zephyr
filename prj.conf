## CMakeLists.txt
```
cmake_minimum_required(VERSION 3.20.0)

# Declare the Zephyr project
find_package(Zephyr REQUIRED HINTS $ENV{ZEPHYR_BASE})
project(wifi_tcp_client)

# Add your application source files here
target_sources(app PRIVATE src/main.c
src/sensor/max30102.c
src/sensor/mlx.c
        )
target_include_directories(app PRIVATE
  ${CMAKE_CURRENT_SOURCE_DIR}/include
)
```

## prj.conf
```kconfig
CONFIG_NETWORKING=y
CONFIG_NET_IPV4=y
CONFIG_NET_TCP=y
CONFIG_NET_SOCKETS=y
CONFIG_NET_SOCKETS_POSIX_NAMES=y

CONFIG_NET_DHCPV4=y

CONFIG_WIFI=y
CONFIG_WIFI_ESWIFI=y

CONFIG_LOG=n
# CONFIG_NET_LOG=y
# CONFIG_WIFI_LOG_LEVEL_DBG=y

CONFIG_MAIN_STACK_SIZE=2048

CONFIG_GPIO=y
CONFIG_SPI=y
CONFIG_I2C=y
CONFIG_I2C_STM32=y
```

## src/main.c
```c
#include <zephyr/kernel.h>

#include <zephyr/kernel.h>
#include <zephyr/net/net_if.h>
#include <zephyr/net/wifi_mgmt.h>
#include <zephyr/net/net_mgmt.h>
#include <zephyr/net/socket.h>

#include <string.h>
#include <errno.h>

#include "max30102.h"


#define WIFI_SSID "MySSID"
#define WIFI_PSK "MyPasswd"

#define SERVER_IP "192.168.29.44"
#define SERVER_PORT 8080

static int tcp_sock = -1;

int wifi_connect(void)
{
    struct net_if *iface = net_if_get_default();
    struct wifi_connect_req_params cnx = {0};

    cnx.ssid = (uint8_t *)WIFI_SSID;
    cnx.ssid_length = strlen(WIFI_SSID);
    cnx.psk = (uint8_t *)WIFI_PSK;
    cnx.psk_length = strlen(WIFI_PSK);
    cnx.security = WIFI_SECURITY_TYPE_PSK;
    cnx.band = WIFI_FREQ_BAND_2_4_GHZ;
    cnx.channel = 0;
    cnx.timeout = SYS_FOREVER_MS;

    printk("Wi-Fi: connecting to %s\n", WIFI_SSID);

    int ret = net_mgmt(NET_REQUEST_WIFI_CONNECT,
                       iface, &cnx, sizeof(cnx));

    if (ret) {
        printk("Wi-Fi connect request failed (%d)\n", ret);
        return ret;
    }

    return 0;
}

int tcp_send(const char *data)
{
    if (tcp_sock < 0) {
        return -ENOTCONN;
    }

    int ret = send(tcp_sock, data, strlen(data), 0);
    if (ret < 0) {
        printk("TCP send error: %d\n", errno);
        return ret;
    }

    return 0;
}

static void handle_command(char cmd)
{
    switch (cmd) {
    case '1':
        printk("Server requested camera data\n");
        tcp_send("{\"cmd\":\"camera\"}\n");
        break;

    case '2':
        printk("Server requested ECG data\n");
        tcp_send("{\"cmd\":\"ecg\"}\n");
        break;

    case '3': {
        printk("Server requested temperature data\n");

        float temp_c = 0.0f;
        float temp_f = 0.0f;

        int ret = mlx_read_avg_temp(&temp_c, &temp_f);
        if (ret < 0) {
            char buf[64];
            snprintf(buf, sizeof(buf), "{\"temperature\":{\"error\":%d}}\n", ret);
            tcp_send(buf);
            break;
        }

        char buf[128];
        snprintf(
            buf, sizeof(buf),
            "{\"temperature\":{\"celsius\":%.2f,\"fahrenheit\":%.2f}}\n",
            temp_c,
            temp_f
        );
        tcp_send(buf);


        break;
    }

    case '4':
        printk("Server requested MAX data\n");
        tcp_send("{\"cmd\":\"MAX\"}\n");
        int lines = max30102_main(max_data);
        for(int i=0;i<lines;i++){
            tcp_send(max_data[i]);
            
        }
        break;

    default:
        printk("Server sent unknown command: %c\n", cmd);
        tcp_send("{\"error\":\"unknown\"}\n");
        break;
    }
}

void tcp_client_start(void)
{
    struct sockaddr_in addr;
    char rx_buf[256];

    tcp_sock = socket(AF_INET, SOCK_STREAM, IPPROTO_TCP);
    if (tcp_sock < 0) {
        printk("TCP socket creation failed\n");
        return;
    }

    addr.sin_family = AF_INET;
    addr.sin_port = htons(SERVER_PORT);
    net_addr_pton(AF_INET, SERVER_IP, &addr.sin_addr);

    printk("TCP: connecting to %s:%d\n", SERVER_IP, SERVER_PORT);

    if (connect(tcp_sock,
                (struct sockaddr *)&addr,
                sizeof(addr)) < 0) {
        printk("TCP connect failed (%d)\n", errno);
        close(tcp_sock);
        tcp_sock = -1;
        return;
    }

    printk("TCP connected\n");
    tcp_send("{\"status\":\"connected\"}\n");

    while (1) {

        printk("Waiting for TCP data...\n");
        int len = recv(tcp_sock, rx_buf, sizeof(rx_buf) - 1, 0);
        if (len > 0) {
            rx_buf[len] = '\0';
            handle_command(rx_buf[0]);
        } else {
            printk("TCP disconnected\n");
            break;
        }
    }

    close(tcp_sock);
    tcp_sock = -1;
}



int main(void)
{
    printk("System boot\n");

    if (wifi_connect() != 0) {
        printk("Wi-Fi setup failed\n");
        return 0;
    }

    k_sleep(K_SECONDS(5));

    printk("Starting TCP client\n");

    tcp_client_start();

    return 0;
}
```

## include/max30102.h
```c
#ifndef MAX30102_H
#define MAX30102_H

#include <stdint.h>
#include <stdbool.h>

/* Data returned to main */
typedef struct {
    uint32_t red;
    uint32_t ir;
    float hr;
    float spo2;
    float pi;
    bool valid;
} max30102_data_t;

#define MAX_LINES 150
#define LINE_LEN  96

static char max_data[MAX_LINES][LINE_LEN];

int max30102_main(char out[MAX_LINES][LINE_LEN]);

#endif /* MAX30102_H */
```

## include/mlx.h
```c
#ifndef MLX_H
#define MLX_H

#include <zephyr/device.h>

/* Initialize MLX90614 (pass I2C device) */
int mlx_init(const struct device *i2c_dev);

/* Read averaged temperature
 * avg_c  -> averaged temperature in Celsius
 * avg_f  -> averaged temperature in Fahrenheit (with +3.8 offset)
 */
int mlx_read_avg_temp(float *avg_c, float *avg_f);

#endif /* MLX_H */
```
